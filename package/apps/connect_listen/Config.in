## package/apps/connect_listen/Config.in
```kconfig
menu "Configuration"
	depends on PACKAGE_connect-listen

config PACKAGE_connect-listen-gitsite
	string "connect-listen git site" if DEVEL
	default "git@www.loongsky1.net:smarthome/transconn.git"
	help
	  git repository site

config PACKAGE_connect-listen-version
	string "connect-listen git version" if DEVEL
	default "smarthome-demo"
	help
	  git version

endmenu
```

## package/apps/shome/Config.in
```kconfig
menu "Configuration"
	depends on PACKAGE_shome-app

config PACKAGE_shome-gitsite
	string "shome git site" if DEVEL
	default "git@loongsky1:openwrt/shome.git"
	help
	  git repository site

config PACKAGE_shome-version
	string "shome git version" if DEVEL
	default "v1.0.2"
	help
	  git version

endmenu
```

## package/apps/smartlab/Config.in
```kconfig
menu "Configuration"
	depends on PACKAGE_smartlab

config PACKAGE_smartlab-gitsite
	string "smartlab git site" if DEVEL
	default "git@www.loongsky1.net:smarthome/transconn.git"
	help
	  git repository site

config PACKAGE_smartlab-version
	string "smartlab git version" if DEVEL
	default "master"
	help
	  git version

endmenu
```

## package/apps/uartsocket/Config.in
```kconfig
menu "Configuration"
	depends on PACKAGE_uartsocket

config PACKAGE_uartsocket-gitsite
	string "uartsocket git site" if DEVEL
	default "https://github.com/xuejian1354/uartsocket.git"
	help
	  git repository site

config PACKAGE_uartsocket-version
	string "uartsocket git version" if DEVEL
	default "master"
	help
	  git version

endmenu
```
